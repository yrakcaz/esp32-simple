## sdkconfig.defaults
```kconfig
# Bluetooth
CONFIG_BT_ENABLED=y
CONFIG_BT_BLE_ENABLED=y
CONFIG_BT_BLUEDROID_ENABLED=n
CONFIG_BT_NIMBLE_ENABLED=y

# Logging
CONFIG_LOG_DEFAULT_LEVEL_INFO=y
CONFIG_BT_NIMBLE_LOG_LEVEL_WARNING=y

# Stacks
CONFIG_ESP_MAIN_TASK_STACK_SIZE=8000
CONFIG_PTHREAD_TASK_STACK_SIZE_DEFAULT=32000
```
